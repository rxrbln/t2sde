## package/network/bacula/config.in
```kconfig
# --- T2-COPYRIGHT-BEGIN ---
# t2/package/*/bacula/config.in
# Copyright (C) 2004 - 2026 The T2 SDE Project
# SPDX-License-Identifier: GPL-2.0
# --- T2-COPYRIGHT-END ---

if pkgcheck bacula X
then
 	menu_begin MENU_PKG_BACULA 'Bacula Package Options'
	text 'Install prefix for bacula packages' \
	     SDECFG_PKG_BACULA_PREFIX "opt/bacula"

	pkgout
	list="client Build_bacula_client_only" ;
	default="client"
	while read pkg ver; do
		if [ "$pkg" = "mysql" ]; then
			default="$pkg"
		elif [ "$default" = "" ]; then
			default="$pkg"
		fi
		list="$list $pkg Use_${pkg}_($ver)_as_DB"
	done < <(grep \
		-e "^X .* mysql " \
		-e "^X .* postgresql " \
		-e "^X .* sqlite " \
		-e "^X .* sqlite2 " config/$config/packages | \
	         cut -f5,6 -d' ' | sort)

	if [ "$list" ]; then
		choice SDECFG_PKG_BACULA_DB $default $list
	fi

	menu_end
fi
```

## package/office/libreoffice/config.in
```kconfig
# --- T2-COPYRIGHT-BEGIN ---
# t2/package/*/libreoffice/config.in
# Copyright (C) 2004 - 2026 The T2 SDE Project
# SPDX-License-Identifier: GPL-2.0
# --- T2-COPYRIGHT-END ---

if pkgcheck openoffice-org X; then
	menu_begin MENU_PKG_OOO 'OpenOffice.org Package Options'

	# Widgets
	#
	CFGTEMP_PKG_OOO_WIDGETS_LIST="none OOO_widgets"
	pkgcheck gtk+2 X && var_append CFGTEMP_PKG_OOO_WIDGETS_LIST ' ' \
		"gnome GTK_native_widgets"
	pkgcheck arts X && var_append CFGTEMP_PKG_OOO_WIDGETS_LIST ' ' \
		"kde KDE_native_widgets"

	choice SDECFG_PKG_OOO_WIDGETS none $CFGTEMP_PKG_OOO_WIDGETS_LIST

	# Icons
	#
	if pkgcheck 'gtk+|arts' X; then
		comment 'Select (additional) icon sets.'
#FIXME: download location		bool 'Bluecurve' SDECFG_PKG_OOO_ICONS_BLUECURVE 1
		pkgcheck gtk+2 X &&	bool 'Gnome' SDECFG_PKG_OOO_ICONS_GNOME 1
		pkgcheck arts X &&	bool 'KDE' SDECFG_PKG_OOO_ICONS_KDE 1
	fi

	menu_end
fi
```

## package/office/ooo/config.in
```kconfig
#!/bin/sh
if pkgcheck ooo X; then
menu_begin MENU_PKG_OOO 'OpenOffice.org (Ximian build features)'
	choice ROCKCFG_PKG_OOO_WIDGETS none	\
		none	'OOO widgets'		\
		gnome	'GTK native widgets'	\
		kde	'KDE native widgets'

	if [ "$ROCKCFG_PKG_OOO_WIDGETS" = "gnome" ]; then
		bool 'Enable bonobo bindings' ROCKCFG_PKG_OOO_BONOBO 0
	fi

	menu_begin MENU_PKG_OOO_ICONS 'Select (additional) icon sets.'
#FIXME: download location		bool 'Bluecurve' ROCKCFG_PKG_OOO_ICONS_BLUECURVE 1
		bool 'KDE' ROCKCFG_PKG_OOO_ICONS_KDE 1
		bool 'Gnome' ROCKCFG_PKG_OOO_ICONS_GNOME 1
	menu_end

	# docdir
menu_end
fi
```

## package/php/php/config.in
```kconfig
# --- T2-COPYRIGHT-BEGIN ---
# t2/package/*/php/config.in
# Copyright (C) 2004 - 2026 The T2 SDE Project
# Copyright (C) 1998 - 2003 ROCK Linux Project
# SPDX-License-Identifier: GPL-2.0
# --- T2-COPYRIGHT-END ---

if pkgcheck php X; then
	menu_begin MENU_PKG_PHP 'PHP Package Options'
		bool 'Enable BC style precision math functions' SDECFG_PKG_PHP_BCMATH 1
		bool 'Force usage of shared modules' SDECFG_PKG_PHP_FORCESHARED 0
		bool 'Enable mbstring ' SDECFG_PKG_PHP_MBSTRING 0
		text 'Extra configure options' SDECFG_PKG_PHP_EXTRACONFOPT ''
		choice SDECFG_PKG_PHP_CGIAPI apache \
			apache Apache_APXS_Support \
			fastcgi FastCGI_Support \
			FPM     FPM_FastCGI_Process_Manager
	menu_end
fi
```

## package/printing/lprng/config.in
```kconfig
# --- T2-COPYRIGHT-BEGIN ---
# t2/package/*/lprng/config.in
# Copyright (C) 2004 - 2026 The T2 SDE Project
# Copyright (C) 1998 - 2003 ROCK Linux Project
# SPDX-License-Identifier: GPL-2.0
# --- T2-COPYRIGHT-END ---

menu_begin MENU_PRINTER 'Printing System'
	pkgout; list=''
	while read pkg ver; do
		list="$list $pkg Use_${pkg}_($ver)_as_standard_printer"
	done < <(grep "^X .* PRINTER " config/$config/packages | cut -f5,6 -d' ')
	list="$list none Do_not_configure_a_default_printer"
	choice SDECFG_DEFAULT_PRINTER none $list
menu_end
```
