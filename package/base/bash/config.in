## package/base/lprng/config.in
```kconfig
menu_begin MENU_PRINTER 'Selecting Print System'
	list=''
	while read pkg ver ; do
		list="$list $pkg Use_${pkg}_($ver)_as_standard_printer"
	done < <(grep "^X .* PRINTER " config/$config/packages | cut -f5,6 -d' ')
	list="$list none Do_not_configure_a_default_printer"
	choice ROCKCFG_DEFAULT_PRINTER none $list
menu_end
```

## package/base/sendmail/config.in
```kconfig
menu_begin MENU_MAILER 'Selecting MTA (mail delivery agent)'
	default=''; list=''
	while read pkg ver ; do
		default=${default:-$pkg}
		[ $pkg = sendmail ] && default=sendmail
		list="$list $pkg Use_${pkg}_($ver)_as_standard_MTA"
	done < <(grep "^X .* MTA " config/$config/packages | cut -f5,6 -d' ')
	list="$list none Do_not_configure_a_default_MTA"
	choice ROCKCFG_DEFAULT_MTA $default $list
menu_end
```

## package/base/sysvinit/config.in
```kconfig
#!/bin/sh
menu_begin MENU_INIT 'Selecting Init'
	# Any package available with INIT flag can be _the_ Init.
	# We will prefer sysvinit, and if no INIT is available a warning
	# will be shown
	# Not being _the_ init doesn't mean the package should be disabled,
	# because it may have usefull tools too.
	# //mnemoc

	CFGTEMP_INIT_LIST=

	for x in `grep -e ' INIT ' config/$config/packages | cut -d' ' -f5`; do
		var_append CFGTEMP_INIT_LIST ' ' \
		"$x $x,_$( grep -e '^\[I\]' package/*/$x/$x.desc \
			| cut -d' ' -f2- | tr ' ' '_' )"
	done

	if [ -z "$CFGTEMP_INIT_LIST" ]; then
		CFGTEMP_INIT_LIST="none WARNING:_No_init_was_selected!"
	fi

	choice ROCKCFG_INIT sysvinit $CFGTEMP_INIT_LIST
	
	# default init must get enabled
	[ "$ROCKCFG_INIT" != "none" ] && pkgenable $ROCKCFG_INIT

	comment ' '

	# do package specific config
	[ -s $cfgtmpdir/subconfig-init.in ] && . $cfgtmpdir/subconfig-init.in

	if [ -n "$CFGTEMP_INIT_INITSTYLES" ]; then
		comment '-- Select Init Style'

		# backguard compatibility
		[ -z "$ROCKCFG_INIT_STYLE" ] && ROCKCFG_INIT_STYLE="$ROCKCFG_PKG_SYSVINIT_INITSTYLE"

		choice ROCKCFG_INIT_STYLE sysv_nice $CFGTEMP_INIT_INITSTYLES
	fi
menu_end
```

## package/editors/vim/config.in
```kconfig
# --- T2-COPYRIGHT-NOTE-BEGIN ---
# T2 SDE: package/*/vim/config.in
# Copyright (C) 2004 - 2022 The T2 SDE Project
# Copyright (C) 1998 - 2003 ROCK Linux Project
# 
# This Copyright note is generated by scripts/Create-CopyPatch,
# more information can be found in the files COPYING and README.
# 
# This program is free software; you can redistribute it and/or modify
# it under the terms of the GNU General Public License version 2.
# --- T2-COPYRIGHT-NOTE-END ---

if pkgcheck vim X
then
	menu_begin MENU_PKG_VIM 'VIM (Vi IMproved) Options'
		choice SDECFG_PKG_VIM_FEATURES huge \
			tiny almost_no_features_enabled,_not_even_multiple_windows \
			small few_features_enabled,_as_basic_as_possible \
			normal a_default_selection_of_features_enabled \
			big many_features_enabled,_as_rich_as_possible \
			huge all_possible_featues_enabled
		choice SDECFG_PKG_VIM_GUI auto \
			no GUI_style:_No_GUI auto GUI_style:_Autoselect \
			gtk GUI_style:_GTK \
			gtk2 GUI_style:_GTK-2 \
			gtk3 GUI_style:_GTK-3 \
			gnome GUI_style:_Gnome \
			gnome2 GUI_style:_Gnome_2 \
			motif GUI_style:_Motif_/_Lesstif

		[ "$SDECFG_PKG_VIM_GUI" != "no" ] &&
			bool 'Build seperate CLI and GUI binaries' \
				SDECFG_PKG_VIM_TWO_BINARIES 1

		bool 'Create VI replacement sym-link' \
			SDECFG_PKG_VIM_IS_VI_REPLACEMENT 1
		pkgcheck perl X &&
			bool 'Include Perl interpreter in vim' \
			SDECFG_PKG_VIM_PERLINTERP 0
		pkgcheck python X &&
			bool 'Include Python interpreter in vim' \
			SDECFG_PKG_VIM_PYTHONINTERP 0
		pkgcheck ruby X &&
			bool 'Include Ruby interpreter in vim' \
			SDECFG_PKG_VIM_RUBYINTERP 0
		pkgcheck tcltk X &&
			bool 'Include TCL interpreter in vim' \
			SDECFG_PKG_VIM_TCLINTERP 0
	menu_end
fi
```
