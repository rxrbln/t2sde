## package/mail/dbmail/config.in
```kconfig
# --- T2-COPYRIGHT-BEGIN ---
# t2/package/*/dbmail/config.in
# Copyright (C) 2004 - 2026 The T2 SDE Project
# Copyright (C) 1998 - 2003 ROCK Linux Project
# SPDX-License-Identifier: GPL-2.0
# --- T2-COPYRIGHT-END ---

if pkgcheck dbmail X
then
	menu_begin MENU_PKG_DBMAIL 'DBMail Package Options'
		for dbpkg in mysql postgresql sqlite; do
			if pkgcheck $dbpkg X; then
				var_append dblist ' ' $dbpkg
				var_append dblist ' ' "${dbpkg}_as_DB_backend"
			fi
		done
		choice SDECFG_PKG_DBMAIL_DB ${dblist%% *} $dblist
		unset dbpkg dblist
	menu_end
fi
```

## package/mail/ezmlm/config.in
```kconfig
# --- T2-COPYRIGHT-BEGIN ---
# t2/package/*/ezmlm/config.in
# Copyright (C) 2006 - 2026 The T2 SDE Project
# SPDX-License-Identifier: GPL-2.0
# --- T2-COPYRIGHT-END ---

if pkgcheck ezmlm X
then
 	menu_begin MENU_PKG_EZMLM 'Ezmlm Package Options'

	comment 'Ezmlm supports 3 ways for storing subscribers:'

	pkgcheck mysql X &&
		sub_choice_mysql="mysql 'Use MySQL for storing subscribers'"

	pkgcheck postgresql X &&
		sub_choice_pgsql="postgresql 'Use PostgreSQL for storing subscriber'"

	choice SDECFG_PKG_EZMLM_SUB filesystem \
		filesystem 'Use standard filesystem for storing subscribers' \
		$sub_choice_mysql \
		$sub_choice_pgsql

	menu_end
fi
```

## package/mail/sendmail/config.in
```kconfig
# --- T2-COPYRIGHT-BEGIN ---
# t2/package/*/sendmail/config.in
# Copyright (C) 2004 - 2026 The T2 SDE Project
# Copyright (C) 1998 - 2003 ROCK Linux Project
# SPDX-License-Identifier: GPL-2.0
# --- T2-COPYRIGHT-END ---

menu_begin MENU_MAILER 'Mail Transfer Agent'
	pkgout
	default='' list=''
	while read pkg ver; do
		default=${default:-$pkg}
		[ $pkg = sendmail ] && default=sendmail
		list="$list $pkg Use_${pkg}_($ver)_as_standard_MTA"
	done < <(grep "^X .* MTA " config/$config/packages | cut -f5,6 -d' ')
	default=${default:-none}
	list="$list none Do_not_configure_a_default_MTA"
	choice SDECFG_DEFAULT_MTA $default $list
menu_end
```
