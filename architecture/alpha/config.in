## architecture/alpha/config.in
```kconfig
# --- T2-COPYRIGHT-BEGIN ---
# t2/architecture/alpha/config.in
# Copyright (C) 2004 - 2025 The T2 SDE Project
# Copyright (C) 1998 - 2003 ROCK Linux Project
# SPDX-License-Identifier: GPL-2.0
# --- T2-COPYRIGHT-END ---

#Description: Alpha (DEC)

choice SDECFG_ALPHA_OPT generic \
	generic		"No special optimization" \
	ev4		"Optimized for 21064 EV4" \
	ev45		"Optimized for 21064 EV45" \
	ev5		"Optimized for 21164 EV5" \
	ev56		"Optimized for 21164A EV56 (BWX)" \
	pca56		"Optimized for 21164pc PCA56 (BWX, MAX)" \
	ev6		"Optimized for 21264 EV6 (BWX, FIX, MAX)" \
	ev67		"Optimized for 21264A EV67 (BWX, CIX, FIX, MAX)"

if [ $SDECFG_ALPHA_OPT != generic ] ; then
	SDECFG_ID="$SDECFG_ID-$SDECFG_ALPHA_OPT"
fi
```

## architecture/arm64/config.in
```kconfig
# --- T2-COPYRIGHT-BEGIN ---
# t2/architecture/arm64/config.in
# Copyright (C) 2004 - 2026 The T2 SDE Project
# SPDX-License-Identifier: GPL-2.0
# --- T2-COPYRIGHT-END ---

#Description: ARM64 (Advanced 64 Bit RISC Machines)

choice SDECFG_ARM64_ENDIANESS el \
	eb	"Build for big endian machines" \
	el	"Build for little endian machines"

if [ $SDECFG_ARM64_ENDIANESS != el ]; then
	SDECFG_ID="${SDECFG_ID}${SDECFG_ARM64_ENDIANESS}"
fi

choice SDECFG_ARM64_OPT generic \
	generic		"Generic Armv8" \
	armv8.1-a	"Armv8.1-A (+crc, +lse, +rdma)" \
	armv8.4-a	"Armv8.4-A (+fp16fml, +dotprod)" \
	armv8.5-a	"Armv8.5-A (+sb, +ssbs, +predres" \
	armv8.6-a	"Armv8.6-A (+bf16, +i8mm)" \
	armv8.7-a	"Armv8.7-A (+ls64)" \
	armv8.8-a	"Armv8.8-A (+mops)" \
	armv9-a		"Armv9-A (+sve, +sve2)"

if [ $SDECFG_ARM64_OPT != generic ]; then
	SDECFG_ID="$SDECFG_ID-$SDECFG_ARM64_OPT"
fi

const SDECFG_MULTILIBLIST ""
SDECFGSET_MULTILIBLIST=""
```

## architecture/avr/config.in
```kconfig
# --- T2-COPYRIGHT-BEGIN ---
# t2/architecture/avr/config.in
# Copyright (C) 2007 - 2026 The T2 SDE Project
# SPDX-License-Identifier: GPL-2.0
# --- T2-COPYRIGHT-END ---

#Description: AVR (Atmel)

choice SDECFG_AVR_OPT default \
	default		"No special optimization"

if [ $SDECFG_AVR_OPT != default ]; then
	SDECFG_ID="$SDECFG_ID-$SDECFG_AVR_OPT"
fi

# Force avr-libc system library
SDECFGSET_LIBC='avr-libc'
```

## architecture/avr32/config.in
```kconfig
# --- T2-COPYRIGHT-BEGIN ---
# t2/architecture/avr32/config.in
# Copyright (C) 2007 - 2026 The T2 SDE Project
# SPDX-License-Identifier: GPL-2.0
# --- T2-COPYRIGHT-END ---

#Description: AVR32 (Atmel)

choice SDECFG_AVR32_OPT default \
	default		"No special optimization"	\
	ap7000		"Optimized for AP7000"

choice SDECFG_AVR32_BOARDDEF none \
	none            "Board config not available, use defconfig" \
	atstk1002       "atstk1002 evaluation board" \
	atstk1003       "atstk1003 evaluation board" \
	atstk1004       "atstk1004 evaluation board" \
	atstk1006       "atatk1006 evaluation board" \
	atngw100        "atngw100 Network Gateway"

if [ $SDECFG_AVR32_OPT != default ]; then
	SDECFG_ID="$SDECFG_ID-$SDECFG_AVR32_OPT"
fi

# Force uClibc system library
SDECFGSET_LIBC='uclibc'
```

## architecture/cris/config.in
```kconfig
# --- T2-COPYRIGHT-BEGIN ---
# t2/architecture/cris/config.in
# Copyright (C) 2004 - 2025 The T2 SDE Project
# SPDX-License-Identifier: GPL-2.0
# --- T2-COPYRIGHT-END ---

#Description: CRIS (Axis)

#	default		"No special optimization"	\
#	v3		"Optimized for v3 ETRAX 4"	\
#	v8		"Optimized for v8 ETRAX 100"	\
choice SDECFG_CRIS_OPT v10 \
	v10		"Optimized for v10 ETRAX 100 LX"

if [ $SDECFG_CRIS_OPT != default ]; then
	SDECFG_ID="$SDECFG_ID-$SDECFG_CRIS_OPT"
fi
```

## architecture/hppa/config.in
```kconfig
# --- T2-COPYRIGHT-BEGIN ---
# t2/architecture/hppa/config.in
# Copyright (C) 2004 - 2026 The T2 SDE Project
# Copyright (C) 1998 - 2003 ROCK Linux Project
# SPDX-License-Identifier: GPL-2.0
# --- T2-COPYRIGHT-END ---

#Description: HPPA (Hewlett Packard Precision Architecture)

# Now the optimizations that result from the options above
choice SDECFG_HPPA_OPT generic \
	generic		"No special optimization" \
	7000 "Optimized for PA7000" \
	7100LXc "Optimized for PA7100LC" \
	7200 "Optimized for PA7200" \
	7300 "Optimized for PA7300" \
	8000 "Optimized for PA8000 and up"

if [ "$SDECFG_HPPA_OPT" != generic ] ; then
	SDECFG_ID="$SDECFG_ID-$SDECFG_HPPA_OPT"
fi
```

## architecture/ia64/config.in
```kconfig
# --- T2-COPYRIGHT-BEGIN ---
# t2/architecture/ia64/config.in
# Copyright (C) 2004 - 2026 The T2 SDE Project
# SPDX-License-Identifier: GPL-2.0
# --- T2-COPYRIGHT-END ---

#Description: IA-64 (Intel Itanium)

# gcc-4.5: Support has been removed for tuning for Itanium1, ...
choice SDECFG_IA64_OPT itanium2				\
	itanium2	"Optimized for Itanium2"

SDECFG_ID="$SDECFG_ID-$SDECFG_IA64_OPT"
```

## architecture/m68k/config.in
```kconfig
# --- T2-COPYRIGHT-BEGIN ---
# t2/architecture/m68k/config.in
# Copyright (C) 2004 - 2026 The T2 SDE Project
# SPDX-License-Identifier: GPL-2.0
# --- T2-COPYRIGHT-END ---

#Description: Motorola 68000

choice SDECFG_M68K_OPT 68020   \
	68020	"Optimized for 68020" \
	68030	"Optimized for 68030" \
	68040	"Optimized for 68040" \
	68060	"Optimized for 68060"

#SDECFG_ID="$SDECFG_ID-$SDECFG_M68K_OPT"
```

## architecture/mips64/config.in
```kconfig
# --- T2-COPYRIGHT-BEGIN ---
# t2/architecture/mips64/config.in
# Copyright (C) 2004 - 2025 The T2 SDE Project
# SPDX-License-Identifier: GPL-2.0
# --- T2-COPYRIGHT-END ---

#Description: MIPS64

choice SDECFG_MIPS64_ENDIANESS EB \
	EB	"Build for big endian machines"	\
	EL	"Build for little endian machines"

SDECFG_ID="$SDECFG_ID-$SDECFG_MIPS64_ENDIANESS"

bool 'Default to 32-bit (N32) for the user-space applications' SDECFG_MIPS64_N32 1

if [ $SDECFG_MIPS64_N32 = 1 ]; then
        SDECFG_ID="$SDECFG_ID-n32"
fi

choice SDECFG_MIPS64_OPT generic		\
	generic "No special optimization"	\
	r5000	"Build for R5000 CPU"		\
	r6000	"Build for R6000 CPU"		\
	r8000	"Build for R8000 CPU"		\
	r10000	"Build for R10000 CPU"		\
	r12000	"Build for R12000 CPU"		\
	r14000	"Build for R14000 CPU"		\
	r16000	"Build for R16000 CPU"		\
	mips64	"Build for MIPS64 CPU"		\
	octeon	"Build for Cavium Octeon"	\
	octeon2	"Build for Cavium Octeon2"	\
	octeon3	"Build for Cavium Octeon3"

if [ $SDECFG_MIPS64_OPT != generic ]; then
	SDECFG_ID="$SDECFG_ID-$SDECFG_MIPS64_OPT"
fi

SDECFGSET_MULTILIB=1
```

## architecture/powerpc/config.in
```kconfig
# --- T2-COPYRIGHT-NOTE-BEGIN ---
# T2 SDE: architecture/powerpc/config.in
# Copyright (C) 2004 - 2024 The T2 SDE Project
# Copyright (C) 1998 - 2003 ROCK Linux Project
# 
# This Copyright note is generated by scripts/Create-CopyPatch,
# more information can be found in the files COPYING and README.
# 
# This program is free software; you can redistribute it and/or modify
# it under the terms of the GNU General Public License version 2.
# --- T2-COPYRIGHT-NOTE-END ---

#Description: PowerPC

choice SDECFG_POWERPC_OPT generic \
	generic		"No special optimization"			\
	601		"Optimized for 601"				\
	602		"Optimized for 602"				\
	603		"Optimized for 603"				\
	603e		"Optimized for 603e"				\
	604		"Optimized for 604"				\
	604e		"Optimized for 604e"				\
	620		"Optimized for 620"				\
	740		"Optimized for 740"				\
	750		"Optimized for 750 (G3)"			\
	espresso	"Optimized for 750/Espresso"			\
	7400		"Optimized for 7400 (G4)"			\
	7450		"Optimized for 7450 (G4+)"			\
	8540		"Optimized for 8540"				\
	970		"Optimized for 970 (G5)"			\
	403		"Optimized for 403"				\
	505		"Optimized for 505"				\
	801		"Optimized for 801"				\
	821		"Optimized for 821"				\
	823		"Optimized for 823"				\
	860		"Optimized for 860"

if [ $SDECFG_POWERPC_OPT != generic ] ; then
	SDECFG_ID="$SDECFG_ID-$SDECFG_POWERPC_OPT"
fi
```

## architecture/powerpc64/config.in
```kconfig
# --- T2-COPYRIGHT-BEGIN ---
# t2/architecture/powerpc64/config.in
# Copyright (C) 2004 - 2025 The T2 SDE Project
# Copyright (C) 1998 - 2003 ROCK Linux Project
# SPDX-License-Identifier: GPL-2.0
# --- T2-COPYRIGHT-END ---

#Description: PowerPC 64

choice SDECFG_POWERPC64_ENDIANESS be \
	be	"Build for big endian machines" \
	le	"Build for little endian machines"

[ "$SDECFG_POWERPC64_ENDIANESS" != "be" ] &&
	SDECFG_ID="${SDECFG_ID}${SDECFG_POWERPC64_ENDIANESS}"

choice SDECFG_POWERPC64_ELF_ABI elfv2 \
	elfv1	"Build for ELFv1 ABI" \
	elfv2	"Build for ELFv2 ABI"

if [ "$SDECFG_POWERPC64_ENDIANESS" != "le" ]; then
choice SDECFG_POWERPC64_OPT generic \
	generic		"No special optimization"			\
	e5500		"Optimized for e5500"				\
	e6500		"Optimized for e6500"				\
	power3		"Optimized for Power3"				\
	power4		"Optimized for Power4"				\
	970		"Optimized for 970 (G5)"			\
	cell		"Optimized for Cell Broadband Engine"		\
	power5		"Optimized for Power5"				\
	power5+		"Optimized for Power5+"				\
	power6		"Optimized for Power6"				\
	power6x		"Optimized for Power6x"				\
	power7		"Optimized for Power7"				\
	power8		"Optimized for Power8"				\
	power9		"Optimized for Power9"				\
	powwe10		"Optimized for Power10"
else
choice SDECFG_POWERPC64_OPT power8 \
	power8		"Optimized for Power8"				\
	power9		"Optimized for Power9"				\
	power10		"Optimized for Power10"
fi

bool 'Default to 32-bit for the user-space applications' SDECFG_POWERPC64_32 0

SDECFGSET_MULTILIB=1

if [ $SDECFG_POWERPC64_OPT != generic ] ; then
	SDECFG_ID="$SDECFG_ID-$SDECFG_POWERPC64_OPT"
fi
```

## architecture/riscv64/config.in
```kconfig
# --- T2-COPYRIGHT-BEGIN ---
# t2/architecture/riscv64/config.in
# Copyright (C) 2016 - 2025 The T2 SDE Project
# SPDX-License-Identifier: GPL-2.0
# --- T2-COPYRIGHT-END ---

#Description: RISC-V 64

choice SDECFG_RISCV64_OPT generic \
	generic		"No special optimization (rv64gc)"	\
	rva20		"Optimized for RVA20 (fence.tso, ...)"	\
	rva22		"Optimized for RVA22 (Zbb, ...)"	\
	rva23		"Optimized for RVA23 (Vector, ...)"	\

SDECFG_ID="$SDECFG_ID-$SDECFG_RISCV64_OPT"
```
