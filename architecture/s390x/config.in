## architecture/s390x/config.in
```kconfig
# --- T2-COPYRIGHT-BEGIN ---
# t2/architecture/s390x/config.in
# Copyright (C) 2016 - 2026 The T2 SDE Project
# SPDX-License-Identifier: GPL-2.0
# --- T2-COPYRIGHT-END ---

#Description: S390x

choice SDECFG_S390X_OPT arch9 \
	arch5	"Optimized for z900" \
	arch6	"Optimized for z990" \
	arch7	"Optimized for z9" \
	arch8	"Optimized for z10" \
	arch9	"Optimized for z196" \
	arch11	"Optimized for z13" \
	arch12	"Optimized for z14" \
	arch13	"Optimized for z15" \
	arch14	"Optimized for z16" \
	arch15	"Optimized for z17"

if [ $SDECFG_S390X_OPT != generic ] ; then
	SDECFG_ID="$SDECFG_ID-$SDECFG_S390X_OPT"
fi
```

## architecture/sparc/config.in
```kconfig
# --- T2-COPYRIGHT-BEGIN ---
# t2/architecture/sparc/config.in
# Copyright (C) 2004 - 2025 The T2 SDE Project
# Copyright (C) 1998 - 2003 ROCK Linux Project
# SPDX-License-Identifier: GPL-2.0
# --- T2-COPYRIGHT-END ---

#Description: SPARC (Sun, Ross, Texas Instruments, Cypress, Fujitsu, LEON)

choice SDECFG_SPARC_OPT leon3 \
	v7		"Optimized for Cypress"		\
	v8		"Optimized for Super/Hyper SPARC"		\
	v9		"Optimized for UltraSPARC"	\
	v9vis		"Optimized for UltraSPARC with VIS"	\
	leon		"Optimized for LEON"		\
	leon3		"Optimized for LEON 3"		\
	leon5		"Optimized for LEON 5"		\

SDECFG_ID="$SDECFG_ID-$SDECFG_SPARC_OPT"

# . architecture/sparc/boot-config.in
```

## architecture/sparc64/config.in
```kconfig
# --- T2-COPYRIGHT-BEGIN ---
# t2/architecture/sparc64/config.in
# Copyright (C) 2006 - 2026 The T2 SDE Project
# SPDX-License-Identifier: GPL-2.0
# --- T2-COPYRIGHT-END ---

#Description: SPARC 64 (Sun Ultra SPARC, Fujitsu)

choice SDECFG_SPARC64_OPT generic   \
	generic		"No special optimization"		\
	ultrasparc	"Optimized for Sun UltraSPARC"		\
	ultrasparc3	"Optimized for Sun UltraSPARC III/III+/IIIi/IIIi+/IV/IV+"	\
	niagara		"Optimized for Sun T1 (Niagara)"	\
	niagara2	"Optimized for Sun T2 (Niagara 2)"	\
	niagara3	"Optimized for Sun T3 (Niagara 3)"	\
	niagara4	"Optimized for Sun T4 (Niagara 4)"	\
	niagara7	"Optimized for Oracle M7 (Niagara 7)"	\
	m8		"Optimized for Oracle M8"

bool 'Default to 32bit for the user-space applications' SDECFG_SPARC64_32BIT 1

SDECFGSET_MULTILIB=1
SDECFG_ID="$SDECFG_ID-$SDECFG_SPARC64_OPT"
[ "$SDECFG_SPARC64_32BIT" = 1 ] && SDECFG_ID="$SDECFG_ID-32"

. architecture/sparc/boot-config.in
```

## architecture/superh/config.in
```kconfig
# --- T2-COPYRIGHT-BEGIN ---
# t2/architecture/superh/config.in
# Copyright (C) 2004 - 2026 The T2 SDE Project
# SPDX-License-Identifier: GPL-2.0
# --- T2-COPYRIGHT-END ---

#Description: SuperH

choice SDECFG_SH_OPT sh4 \
	sh		"No special optimization (SH1)"	\
	sh2		"Optimized for the SH2"	\
	sh3		"Optimized for the SH3"	\
	sh4		"Optimized for the SH4"

choice SDECFG_SH_BOARDDEF dreamcast \
	dreamcast	"SEGA Dreamcast" \
	se7300		"Hitachi SH7300 (SH-Mobile V) evaluation board" \
	se73180		"Hitachi SH73180 (SH-Mobile 3) evaluation board" \
	se7751		"Hitachi SH7751 evalutation board" \
	se7705		"Hitachi SH7709 or SH7750 evaluation board" \
	cqreek		"CqREEK SH7708 or SH7750" \
	hp6xx		"HP Jornada HP6xx" \
	microdev	"SuperH MicroDev board with an SH4-202 CPU" \
	rts7751r2dplus	"Renesas Technology Sales SH-Graphics board" \
	sh3		"CTP/PCI-SH03 by Interface Corporation" \
	snapgear	"SnapGear SH board" \
	systemh		"Renesas SystemH 7751R evaluation board"

SDECFG_ID="$SDECFG_ID-$SDECFG_SH_OPT"

# TODO: should certainly be in sync w/ optimization choice!
const SDECFG_MULTILIBLIST "m4,m4-nofpu"
SDECFGSET_MULTILIBLIST="m4,m4-nofpu"
```

## architecture/x86-64/config.in
```kconfig
# --- T2-COPYRIGHT-BEGIN ---
# t2/architecture/x86-64/config.in
# Copyright (C) 2004 - 2025 The T2 SDE Project
# Copyright (C) 1998 - 2003 ROCK Linux Project
# SPDX-License-Identifier: GPL-2.0
# --- T2-COPYRIGHT-END ---

#Description: x86-64 (AMD64, Intel EM64T)

choice SDECFG_X8664_OPT generic \
	generic		"No special optimization"		\
	x86-64-v2	"Optimized for x86-64-v2 (SSE3, SSSE3, SSE4, POPCNT)"	\
	x86-64-v3	"Optimized for x86-64-v3 (AVX, AVX2, BMI, FMA, MOVBE)"	\
	x86-64-v4	"Optimized for x86-64-v4 (AVX512{F,BW,CD,DQ,VL})"	\
	k8		"Optimized for 1st gen AMD K8 / Opteron (SSE2, 3DNow!)"	\
	k8-sse3		"Optimized for AMD K8 with SSE3"	\
	amdfam10	"Optimized for AMD K10 (Family 10h, SSE4A)"		\
	bdver1		"Optimized for AMD Bulldozer (Family 15h, SSSE3, AVX)"	\
	bdver2		"Optimized for AMD Piledriver (Family 15h, FMA)"	\
	bdver3		"Optimized for AMD Steamroller (Family 15h)"	\
	bdver4		"Optimized for AMD Excavator (Family 15h, AVX2)"	\
	btver1		"Optimized for AMD Bobcat (Family 14h)"	\
	btver2		"Optimized for AMD Jaguar (Family 16h, AVX)"	\
	znver1		"Optimized for AMD Zen (Family 17h, AVX2)"		\
	znver2		"Optimized for AMD Zen 2 (Family 17h, FP-256)" \
	znver3		"Optimized for AMD Zen 3 (Family 19h, VPCLMULQDQ, VAES)" \
	znver4		"Optimized for AMD Zen 4 (Family 19h, AVX512)" \
	znver5		"Optimized for AMD Zen 5 (Family 1Ah, AVX512, VNNI)" \
	nocona		"Optimized for Intel EM64T (Pentium 4, Xeon, SSE3)"	\
	core2		"Optimized for Intel Core2 (SSSE3)"		\
	nehalem		"Optimized for Intel Core-i 1-gen (Nehalem)"	\
	westmere	"Optimized for Intel Core-i 1-gen (Westmere)"	\
	sandybridge	"Optimized for Intel Core-i 2-gen (Sandybridge, AVX)"	\
	ivybridge	"Optimized for Intel Core-i 3-gen (Ivybridge)"	\
	haswell		"Optimized for Intel Core-i 4-gen (Haswell, AVX2)"	\
	broadwell	"Optimized for Intel Core-i 5-gen (Broadwell)"	\
	skylake		"Optimized for Intel Core-i 6-gen (Skylake)"	\
	skylake-avx512	"Optimized for Intel Core-i 6-gen (Skylake, AVX512)"	\
	cannonlake	"Optimized for Intel Core-i 9-gen (Cannonlake, AVX512)" \
	icelake-client	"Optimized for Intel Core-i 10-gen (Icelake)" \
	atom		"Optimized for Intel Atom" \
	bonnell		"Optimized for Intel Atom Bonnel"	\
	silvermont	"Optimized for Intel Atom Silvermont"

bool 'Default to 32-bit (X32) for the user-space applications' SDECFG_X8664_X32 0

if [ $SDECFG_X8664_OPT != generic ] ; then
	SDECFG_ID="$SDECFG_ID-$SDECFG_X8664_OPT"
fi

SDECFGSET_MULTILIB=1

if [ "$SDECFG_X8664_X32" = 1 ]; then
	# gcc's default would only be mx32 in this case
	SDECFG_ID="$SDECFG_ID-x32"
	const SDECFG_MULTILIBLIST "mx32,m32"
	SDECFGSET_MULTILIBLIST="mx32,m32"
fi

. architecture/x86/boot-config.in
```

## architecture/x86/config.in
```kconfig
# --- T2-COPYRIGHT-BEGIN ---
# t2/architecture/x86/config.in
# Copyright (C) 2004 - 2026 The T2 SDE Project
# Copyright (C) 1998 - 2003 ROCK Linux Project
# SPDX-License-Identifier: GPL-2.0
# --- T2-COPYRIGHT-END ---

#Description: x86 (AMD, Intel, VIA and compatible)

choice SDECFG_X86_OPT i486   \
	generic		"No special optimization"		\
	i386		"Optimized for Intel 386"		\
	i486		"Optimized for Intel 486"		\
	c3		"Optimized for VIA CyrixIII/VIA-C3"	\
	c3-2		"Optimized for VIA-C3-2 Nemiah"		\
	c7		"Optimized for VIA-C7 Esther"		\
	i586		"Optimized for Intel i586 (Pentium)"		\
	i586-mmx	"Optimized for Intel i586 (Pentium) with MMX"	\
	i686		"Optimized for 686 class CPU with CMOV"		\
	i686-mmx	"Optimized for 686 class CPU with MMX"	\
	pentiumpro	"Optimized for Intel Pentium Pro"	\
	pentium2	"Optimized for Intel Pentium 2"		\
	pentium3	"Optimized for Intel Pentium 3 with SSE"		\
	pentium4	"Optimized for Intel Pentium 4"		\
	pentium-m	"Optimized for Intel Pentium M (Centrino)"	\
	prescott	"Optimized for Intel Pentium 4 with SSE3"	\
	nocona		"Optimized for Intel Core Solo/Duo"	\
	core2		"Optimized for Intel Core2"		\
	atom		"Optimized for Intel Atom"		\
	geode		"Optimized for NSC Geode GX"		\
	geode2		"Optimized for NSC Geode GX2, AMD Geode LX"	\
	k6		"Optimized for AMD K6"			\
	k6-2		"Optimized for AMD K6-2"		\
	k6-3		"Optimized for AMD K6-3"		\
	athlon		"Optimized for AMD Athlon"		\
	athlon-tbird	"Optimized for AMD Athlon Thunderbird"	\
	athlon-4	"Optimized for AMD Athlon 4"		\
	athlon-xp	"Optimized for AMD Athlon XP"		\
	athlon-mp	"Optimized for AMD Athlon MP"

bool 'Optimize for the Xen hypervisor' SDECFG_X86_OPT_XEN 0

if [ $SDECFG_X86_OPT != generic ] ; then
	SDECFG_ID="$SDECFG_ID-$SDECFG_X86_OPT"
fi

. architecture/x86/boot-config.in
```
